## config/boards/arm/lgpg/Kconfig.txt
```kconfig
# LGPG board configuration

# Copyright (c) 2020 The ZMK Contributors
# SPDX-License-Identifier: MIT

config BOARD_LGPG
	bool "LGPG"
	depends on SOC_NRF52840_QIAA
```
